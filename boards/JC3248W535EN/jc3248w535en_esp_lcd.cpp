#include "jc3248w535en_esp_lcd.h"

#include <Arduino.h>
#include <esp_heap_caps.h>
#include <esp_lcd_panel_io.h>
#include <esp_lcd_panel_ops.h>
#include <esp_lcd_panel_vendor.h>
#include <esp_log.h>
#include <driver/spi_master.h>
#include <freertos/FreeRTOS.h>
#include <freertos/semphr.h>

#include "../../lib/HAL/display/esp_lcd_axs15231b.h"
#include "pins_arduino.h"

namespace {
constexpr uint32_t kWidth = 320;
constexpr uint32_t kHeight = 480;
constexpr uint32_t kPixels = kWidth * kHeight;
constexpr uint32_t kTransportPixels = 15360;
constexpr uint32_t kTransportBytes = kTransportPixels * sizeof(uint16_t);
constexpr uint32_t kMaxTransferBytes = kPixels * sizeof(uint16_t);
constexpr uint16_t kRed = 0xF800;
constexpr uint16_t kGreen = 0x07E0;
constexpr uint16_t kBlue = 0x001F;
constexpr uint16_t kWhite = 0xFFFF;

static const axs15231b_lcd_init_cmd_t lcd_init_cmds[] = {
    {0xBB, (uint8_t []){0x00, 0x00, 0x00, 0x00, 0x00, 0x00, 0x5A, 0xA5}, 8, 0},
    {0xA0, (uint8_t []){0xC0, 0x10, 0x00, 0x02, 0x00, 0x00, 0x04, 0x3F, 0x20, 0x05, 0x3F, 0x3F, 0x00, 0x00, 0x00, 0x00, 0x00}, 17, 0},
    {0xA2, (uint8_t []){0x30, 0x3C, 0x24, 0x14, 0xD0, 0x20, 0xFF, 0xE0, 0x40, 0x19, 0x80, 0x80, 0x80, 0x20, 0xf9, 0x10, 0x02, 0xff, 0xff, 0xF0, 0x90, 0x01, 0x32, 0xA0, 0x91, 0xE0, 0x20, 0x7F, 0xFF, 0x00, 0x5A}, 31, 0},
    {0xD0, (uint8_t []){0xE0, 0x40, 0x51, 0x24, 0x08, 0x05, 0x10, 0x01, 0x20, 0x15, 0x42, 0xC2, 0x22, 0x22, 0xAA, 0x03, 0x10, 0x12, 0x60, 0x14, 0x1E, 0x51, 0x15, 0x00, 0x8A, 0x20, 0x00, 0x03, 0x3A, 0x12}, 30, 0},
    {0xA3, (uint8_t []){0xA0, 0x06, 0xAa, 0x00, 0x08, 0x02, 0x0A, 0x04, 0x04, 0x04, 0x04, 0x04, 0x04, 0x04, 0x04, 0x04, 0x04, 0x04, 0x04, 0x00, 0x55, 0x55}, 22, 0},
    {0xC1, (uint8_t []){0x31, 0x04, 0x02, 0x02, 0x71, 0x05, 0x24, 0x55, 0x02, 0x00, 0x41, 0x00, 0x53, 0xFF, 0xFF, 0xFF, 0x4F, 0x52, 0x00, 0x4F, 0x52, 0x00, 0x45, 0x3B, 0x0B, 0x02, 0x0d, 0x00, 0xFF, 0x40}, 30, 0},
    {0xC3, (uint8_t []){0x00, 0x00, 0x00, 0x50, 0x03, 0x00, 0x00, 0x00, 0x01, 0x80, 0x01}, 11, 0},
    {0xC4, (uint8_t []){0x00, 0x24, 0x33, 0x80, 0x00, 0xea, 0x64, 0x32, 0xC8, 0x64, 0xC8, 0x32, 0x90, 0x90, 0x11, 0x06, 0xDC, 0xFA, 0x00, 0x00, 0x80, 0xFE, 0x10, 0x10, 0x00, 0x0A, 0x0A, 0x44, 0x50}, 29, 0},
    {0xC5, (uint8_t []){0x18, 0x00, 0x00, 0x03, 0xFE, 0x3A, 0x4A, 0x20, 0x30, 0x10, 0x88, 0xDE, 0x0D, 0x08, 0x0F, 0x0F, 0x01, 0x3A, 0x4A, 0x20, 0x10, 0x10, 0x00}, 23, 0},
    {0xC6, (uint8_t []){0x05, 0x0A, 0x05, 0x0A, 0x00, 0xE0, 0x2E, 0x0B, 0x12, 0x22, 0x12, 0x22, 0x01, 0x03, 0x00, 0x3F, 0x6A, 0x18, 0xC8, 0x22}, 20, 0},
    {0xC7, (uint8_t []){0x50, 0x32, 0x28, 0x00, 0xa2, 0x80, 0x8f, 0x00, 0x80, 0xff, 0x07, 0x11, 0x9c, 0x67, 0xff, 0x24, 0x0c, 0x0d, 0x0e, 0x0f}, 20, 0},
    {0xC9, (uint8_t []){0x33, 0x44, 0x44, 0x01}, 4, 0},
    {0xCF, (uint8_t []){0x2C, 0x1E, 0x88, 0x58, 0x13, 0x18, 0x56, 0x18, 0x1E, 0x68, 0x88, 0x00, 0x65, 0x09, 0x22, 0xC4, 0x0C, 0x77, 0x22, 0x44, 0xAA, 0x55, 0x08, 0x08, 0x12, 0xA0, 0x08}, 27, 0},
    {0xD5, (uint8_t []){0x40, 0x8E, 0x8D, 0x01, 0x35, 0x04, 0x92, 0x74, 0x04, 0x92, 0x74, 0x04, 0x08, 0x6A, 0x04, 0x46, 0x03, 0x03, 0x03, 0x03, 0x82, 0x01, 0x03, 0x00, 0xE0, 0x51, 0xA1, 0x00, 0x00, 0x00}, 30, 0},
    {0xD6, (uint8_t []){0x10, 0x32, 0x54, 0x76, 0x98, 0xBA, 0xDC, 0xFE, 0x93, 0x00, 0x01, 0x83, 0x07, 0x07, 0x00, 0x07, 0x07, 0x00, 0x03, 0x03, 0x03, 0x03, 0x03, 0x03, 0x00, 0x84, 0x00, 0x20, 0x01, 0x00}, 30, 0},
    {0xD7, (uint8_t []){0x03, 0x01, 0x0b, 0x09, 0x0f, 0x0d, 0x1E, 0x1F, 0x18, 0x1d, 0x1f, 0x19, 0x40, 0x8E, 0x04, 0x00, 0x20, 0xA0, 0x1F}, 19, 0},
    {0xD8, (uint8_t []){0x02, 0x00, 0x0a, 0x08, 0x0e, 0x0c, 0x1E, 0x1F, 0x18, 0x1d, 0x1f, 0x19}, 12, 0},
    {0xD9, (uint8_t []){0x1F, 0x1F, 0x1F, 0x1F, 0x1F, 0x1F, 0x1F, 0x1F, 0x1F, 0x1F, 0x1F, 0x1F}, 12, 0},
    {0xDD, (uint8_t []){0x1F, 0x1F, 0x1F, 0x1F, 0x1F, 0x1F, 0x1F, 0x1F, 0x1F, 0x1F, 0x1F, 0x1F}, 12, 0},
    {0xDF, (uint8_t []){0x44, 0x73, 0x4B, 0x69, 0x00, 0x0A, 0x02, 0x90}, 8,  0},
    {0xE0, (uint8_t []){0x3B, 0x28, 0x10, 0x16, 0x0c, 0x06, 0x11, 0x28, 0x5c, 0x21, 0x0D, 0x35, 0x13, 0x2C, 0x33, 0x28, 0x0D}, 17, 0},
    {0xE1, (uint8_t []){0x37, 0x28, 0x10, 0x16, 0x0b, 0x06, 0x11, 0x28, 0x5C, 0x21, 0x0D, 0x35, 0x14, 0x2C, 0x33, 0x28, 0x0F}, 17, 0},
    {0xE2, (uint8_t []){0x3B, 0x07, 0x12, 0x18, 0x0E, 0x0D, 0x17, 0x35, 0x44, 0x32, 0x0C, 0x14, 0x14, 0x36, 0x3A, 0x2F, 0x0D}, 17, 0},
    {0xE3, (uint8_t []){0x37, 0x07, 0x12, 0x18, 0x0E, 0x0D, 0x17, 0x35, 0x44, 0x32, 0x0C, 0x14, 0x14, 0x36, 0x32, 0x2F, 0x0F}, 17, 0},
    {0xE4, (uint8_t []){0x3B, 0x07, 0x12, 0x18, 0x0E, 0x0D, 0x17, 0x39, 0x44, 0x2E, 0x0C, 0x14, 0x14, 0x36, 0x3A, 0x2F, 0x0D}, 17, 0},
    {0xE5, (uint8_t []){0x37, 0x07, 0x12, 0x18, 0x0E, 0x0D, 0x17, 0x39, 0x44, 0x2E, 0x0C, 0x14, 0x14, 0x36, 0x3A, 0x2F, 0x0F}, 17, 0},
    {0xA4, (uint8_t []){0x85, 0x85, 0x95, 0x82, 0xAF, 0xAA, 0xAA, 0x80, 0x10, 0x30, 0x40, 0x40, 0x20, 0xFF, 0x60, 0x30}, 16, 0},
    {0xA4, (uint8_t []){0x85, 0x85, 0x95, 0x85}, 4, 0},
    {0xBB, (uint8_t []){0x00, 0x00, 0x00, 0x00, 0x00, 0x00, 0x00, 0x00}, 8, 0},
    {0x13, (uint8_t []){0x00}, 0, 0},
    {0x11, (uint8_t []){0x00}, 0, 120},
    {0x2C, (uint8_t []){0x00, 0x00, 0x00, 0x00}, 4, 0},
};

esp_lcd_panel_io_handle_t s_io = nullptr;
esp_lcd_panel_handle_t s_panel = nullptr;
SemaphoreHandle_t s_trans_done_sem = nullptr;
uint16_t *s_trans_buf_1 = nullptr;
uint16_t *s_trans_buf_2 = nullptr;

static bool on_color_trans_done(esp_lcd_panel_io_handle_t, esp_lcd_panel_io_event_data_t *, void *) {
    BaseType_t task_awake = pdFALSE;
    if (s_trans_done_sem) xSemaphoreGiveFromISR(s_trans_done_sem, &task_awake);
    return task_awake == pdTRUE;
}

uint16_t panel565(uint16_t color) {
    return static_cast<uint16_t>((color >> 8) | (color << 8));
}

void fill_quadrants(uint16_t *frame) {
    const uint16_t colors[2][2] = {{panel565(kRed), panel565(kGreen)}, {panel565(kBlue), panel565(kWhite)}};
    for (uint32_t y = 0; y < kHeight; ++y) {
        for (uint32_t x = 0; x < kWidth; ++x) {
            const bool right = x >= kWidth / 2;
            const bool bottom = y >= kHeight / 2;
            frame[y * kWidth + x] = colors[bottom][right];
        }
    }
}

void flush_frame(uint16_t *frame) {
    constexpr uint32_t rows_per_transfer = kTransportPixels / kWidth;
    uint16_t *transport = s_trans_buf_1;
    for (uint32_t y = 0; y < kHeight; y += rows_per_transfer) {
        const uint32_t rows = ((kHeight - y) < rows_per_transfer) ? (kHeight - y) : rows_per_transfer;
        memcpy(transport, frame + y * kWidth, rows * kWidth * sizeof(uint16_t));
        Serial.printf("[CHUNK %u] esp_lcd draw y=%u rows=%u\\n", (unsigned)(y / rows_per_transfer), (unsigned)y, (unsigned)rows);
        ESP_ERROR_CHECK(esp_lcd_panel_draw_bitmap(s_panel, 0, y, kWidth, y + rows, transport));
        xSemaphoreTake(s_trans_done_sem, portMAX_DELAY);
        transport = (transport == s_trans_buf_1) ? s_trans_buf_2 : s_trans_buf_1;
    }
}
} // namespace

void jc3248w535en_esp_lcd_init() {
    // Same AXS15231B_PANEL_BUS_QSPI_CONFIG values as OBD.  Assignment form
    // is required here because this translation unit is C++ and the current
    // ESP-IDF anonymous-union field order rejects the C designated initializer.
    spi_bus_config_t buscfg = {};
    buscfg.sclk_io_num = TFT_SCLK;
    buscfg.data0_io_num = TFT_D0;
    buscfg.data1_io_num = TFT_D1;
    buscfg.data2_io_num = TFT_D2;
    buscfg.data3_io_num = TFT_D3;
    buscfg.max_transfer_sz = kMaxTransferBytes;
    ESP_LOGI("JC3248", "Initialize SPI2 QSPI bus");
    ESP_ERROR_CHECK(spi_bus_initialize(SPI2_HOST, &buscfg, SPI_DMA_CH_AUTO));

    const esp_lcd_panel_io_spi_config_t io_config = AXS15231B_PANEL_IO_QSPI_CONFIG(TFT_CS, on_color_trans_done, nullptr);
    ESP_LOGI("JC3248", "Install esp_lcd_panel_io_spi");
    ESP_ERROR_CHECK(esp_lcd_new_panel_io_spi((esp_lcd_spi_bus_handle_t)SPI2_HOST, &io_config, &s_io));

    static const axs15231b_vendor_config_t vendor_config = {
        .init_cmds = lcd_init_cmds,
        .init_cmds_size = sizeof(lcd_init_cmds) / sizeof(lcd_init_cmds[0]),
        .flags = {.use_qspi_interface = 1},
    };
    const esp_lcd_panel_dev_config_t panel_config = {
        .reset_gpio_num = GPIO_NUM_NC,
        .rgb_ele_order = LCD_RGB_ELEMENT_ORDER_RGB,
        .bits_per_pixel = 16,
        .vendor_config = (void *)&vendor_config,
    };
    ESP_LOGI("JC3248", "Install literal OBD AXS15231B driver");
    ESP_ERROR_CHECK(esp_lcd_new_panel_axs15231b(s_io, &panel_config, &s_panel));

    s_trans_done_sem = xSemaphoreCreateCounting(1, 0);
    s_trans_buf_1 = static_cast<uint16_t *>(heap_caps_malloc(kTransportBytes, MALLOC_CAP_DMA));
    s_trans_buf_2 = static_cast<uint16_t *>(heap_caps_malloc(kTransportBytes, MALLOC_CAP_DMA));
    if (!s_trans_done_sem || !s_trans_buf_1 || !s_trans_buf_2) abort();

    ESP_ERROR_CHECK(esp_lcd_panel_reset(s_panel));
    ESP_ERROR_CHECK(esp_lcd_panel_init(s_panel));
    ESP_ERROR_CHECK(esp_lcd_panel_disp_on_off(s_panel, false));
    Serial.println("[JC3248] esp_lcd panel initialized");
}

[[noreturn]] void jc3248w535en_esp_lcd_test() {
    uint16_t *frame = static_cast<uint16_t *>(heap_caps_malloc(kPixels * sizeof(uint16_t), MALLOC_CAP_SPIRAM));
    if (!frame) abort();
    fill_quadrants(frame);
    Serial.println("[JC3248] static quadrant test 320x480");
    flush_frame(frame);
    Serial.println("[JC3248] quadrant pattern held; no further frame");
    Serial.flush();
    while (true) vTaskDelay(pdMS_TO_TICKS(1000));
}

void jc3248w535en_esp_lcd_present_physical(const uint16_t *physical_frame) {
    if (!physical_frame || !s_panel || !s_trans_done_sem || !s_trans_buf_1 || !s_trans_buf_2) return;

    // Geometry is already physical 320x480 here. Keep the validated DMA
    // chunking unchanged and only encode RGB565 into the panel byte order.
    constexpr uint32_t rows_per_transfer = kTransportPixels / kWidth;
    uint16_t *transport = s_trans_buf_1;
    for (uint32_t y = 0; y < kHeight; y += rows_per_transfer) {
        const uint32_t rows = ((kHeight - y) < rows_per_transfer) ? (kHeight - y) : rows_per_transfer;
        const uint32_t transfer_pixels = rows * kWidth;
        const uint32_t physical_offset = y * kWidth;
        for (uint32_t i = 0; i < transfer_pixels; ++i) {
            transport[i] = panel565(physical_frame[physical_offset + i]);
        }
        Serial.printf("[GFX FLUSH] physical y=%u rows=%u\\n", (unsigned)y, (unsigned)rows);
        ESP_ERROR_CHECK(esp_lcd_panel_draw_bitmap(s_panel, 0, y, kWidth, y + rows, transport));
        xSemaphoreTake(s_trans_done_sem, portMAX_DELAY);
        transport = (transport == s_trans_buf_1) ? s_trans_buf_2 : s_trans_buf_1;
    }
}
